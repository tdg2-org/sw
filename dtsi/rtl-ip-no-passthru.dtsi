// don't use this. append method is better. see readme
&M_AXI_iic_0 {
  compatible = "xlnx,axi-iic-2.1", "xlnx,xps-iic-2.00.a";
  reg = <0x0 0xa0001000 0x0 0x200>;
  status = "okay";
  xlnx,ten-bit-adr = <0>;
  xlnx,gpo-width = <1>;
  clocks = <&zynqmp_clk 71>;
  clock-names = "s_axi_aclk";
};

&amba_pl {
  axi_iic_pl2_inst: axi_iic_pl2_inst@a0002000 {
    compatible = "xlnx,axi-iic-2.1", "xlnx,xps-iic-2.00.a";
    reg = <0x0 0xa0002000 0x0 0x200>;
    status = "okay";
    xlnx,ten-bit-adr = <0>;
    xlnx,gpo-width = <1>;
    clocks = <&zynqmp_clk 71>;
    clock-names = "s_axi_aclk";
  };
};

&cpus_a53 {
  /delete-property/ address-map;
  address-map = <0x0 0xf0000000 &amba 0x0 0xf0000000 0x0 0x10000000>, 
  	      <0x0 0xf9000000 &amba_apu 0x0 0xf9000000 0x0 0x80000>, 
  	      <0x0 0x0 &zynqmp_reset 0x0 0x0 0x0 0x0>, 
  	      <0x0 0x0 &pinctrl0 0x0 0x0 0x0 0x0>, 
  	      <0x0 0xffa50800 &ams_ps 0x0 0xffa50800 0x0 0x400>, 
  	      <0x0 0xffa50c00 &ams_pl 0x0 0xffa50c00 0x0 0x400>, 
  	      <0x0 0xFFFC0000 &psu_ocm_ram_0_memory 0x0 0xFFFC0000 0x0 0x40000>, 
  	      <0x0 0xff300000 &ipi0 0x0 0xff300000 0x0 0x10000>, 
  	      <0x0 0x0 &psu_ddr_0_memory 0x0 0x0 0x0 0x3FF00000>, 
  	      <0x0 0xa0000000 &pl_axil_reg32_0 0x0 0xa0000000 0x0 0x80>, 
  	      <0x0 0xa0001000 &M_AXI_iic_0 0x0 0xa0001000 0x0 0x200>, 
  	      <0x0 0xa0002000 &axi_iic_pl2_inst 0x0 0xa0002000 0x0 0x200>,
          <0x0 0xa0010000 &axi_iic_0 0x0 0xa0010000 0x0 0x200>, 
  	      <0x0 0xf9010000 &gic_a53 0x0 0xf9010000 0x0 0x70000>, 
  	      <0x0 0xffa80000 &lpd_dma_chan1 0x0 0xffa80000 0x0 0x10000>, 
  	      <0x0 0xffa90000 &lpd_dma_chan2 0x0 0xffa90000 0x0 0x10000>, 
  	      <0x0 0xffaa0000 &lpd_dma_chan3 0x0 0xffaa0000 0x0 0x10000>, 
  	      <0x0 0xffab0000 &lpd_dma_chan4 0x0 0xffab0000 0x0 0x10000>, 
  	      <0x0 0xffac0000 &lpd_dma_chan5 0x0 0xffac0000 0x0 0x10000>, 
  	      <0x0 0xffad0000 &lpd_dma_chan6 0x0 0xffad0000 0x0 0x10000>, 
  	      <0x0 0xffae0000 &lpd_dma_chan7 0x0 0xffae0000 0x0 0x10000>, 
  	      <0x0 0xffaf0000 &lpd_dma_chan8 0x0 0xffaf0000 0x0 0x10000>, 
  	      <0x0 0xfd360000 &psu_afi_0 0x0 0xfd360000 0x0 0x10000>, 
  	      <0x0 0xfd370000 &psu_afi_1 0x0 0xfd370000 0x0 0x10000>, 
  	      <0x0 0xfd380000 &psu_afi_2 0x0 0xfd380000 0x0 0x10000>, 
  	      <0x0 0xfd390000 &psu_afi_3 0x0 0xfd390000 0x0 0x10000>, 
  	      <0x0 0xfd3a0000 &psu_afi_4 0x0 0xfd3a0000 0x0 0x10000>, 
  	      <0x0 0xfd3b0000 &psu_afi_5 0x0 0xfd3b0000 0x0 0x10000>, 
  	      <0x0 0xff9b0000 &psu_afi_6 0x0 0xff9b0000 0x0 0x10000>, 
  	      <0x0 0xffa50000 &xilinx_ams 0x0 0xffa50000 0x0 0x10000>, 
  	      <0x0 0xfd0b0000 &perf_monitor_ddr 0x0 0xfd0b0000 0x0 0x10000>, 
  	      <0x0 0xffa00000 &perf_monitor_ocm 0x0 0xffa00000 0x0 0x10000>, 
  	      <0x0 0xffa10000 &perf_monitor_lpd 0x0 0xffa10000 0x0 0x10000>, 
  	      <0x0 0xfd490000 &perf_monitor_cci 0x0 0xfd490000 0x0 0x10000>, 
  	      <0x0 0xfd5c0000 &psu_apu 0x0 0xfd5c0000 0x0 0x10000>, 
  	      <0x0 0xfd6e0000 &psu_cci_gpv 0x0 0xfd6e0000 0x0 0x10000>, 
  	      <0x0 0xfd5e0000 &psu_cci_reg 0x0 0xfd5e0000 0x0 0x10000>, 
  	      <0x0 0xfe800000 &coresight_0 0x0 0xfe800000 0x0 0x800000>, 
  	      <0x0 0xfd1a0000 &psu_crf_apb 0x0 0xfd1a0000 0x0 0x140000>, 
  	      <0x0 0xff5e0000 &psu_crl_apb 0x0 0xff5e0000 0x0 0x280000>, 
  	      <0x0 0xffca0000 &psu_csu_0 0x0 0xffca0000 0x0 0x10000>, 
  	      <0x0 0xffc80000 &csudma_0 0x0 0xffc80000 0x0 0x20000>, 
  	      <0x0 0xff380000 &psu_ctrl_ipi 0x0 0xff380000 0x0 0x80000>, 
  	      <0x0 0xfd080000 &psu_ddr_phy 0x0 0xfd080000 0x0 0x10000>, 
  	      <0x0 0xfd090000 &psu_ddr_qos_ctrl 0x0 0xfd090000 0x0 0x10000>, 
  	      <0x0 0xfd000000 &psu_ddr_xmpu0_cfg 0x0 0xfd000000 0x0 0x10000>, 
  	      <0x0 0xfd010000 &psu_ddr_xmpu1_cfg 0x0 0xfd010000 0x0 0x10000>, 
  	      <0x0 0xfd020000 &psu_ddr_xmpu2_cfg 0x0 0xfd020000 0x0 0x10000>, 
  	      <0x0 0xfd030000 &psu_ddr_xmpu3_cfg 0x0 0xfd030000 0x0 0x10000>, 
  	      <0x0 0xfd040000 &psu_ddr_xmpu4_cfg 0x0 0xfd040000 0x0 0x10000>, 
  	      <0x0 0xfd050000 &psu_ddr_xmpu5_cfg 0x0 0xfd050000 0x0 0x10000>, 
  	      <0x0 0xfd070000 &mc 0x0 0xfd070000 0x0 0x1000>, 
  	      <0x0 0xfd4a0000 &zynqmp_dpsub 0x0 0xfd4a0000 0x0 0x10000>, 
  	      <0x0 0xfd4c0000 &zynqmp_dpdma 0x0 0xfd4c0000 0x0 0x10000>, 
  	      <0x0 0xffcc0000 &psu_efuse 0x0 0xffcc0000 0x0 0x10000>, 
  	      <0x0 0xff0d0000 &gem2 0x0 0xff0d0000 0x0 0x10000>, 
  	      <0x0 0xfd700000 &psu_fpd_gpv 0x0 0xfd700000 0x0 0x100000>, 
  	      <0x0 0xfd610000 &psu_fpd_slcr 0x0 0xfd610000 0x0 0x80000>, 
  	      <0x0 0xfd690000 &psu_fpd_slcr_secure 0x0 0xfd690000 0x0 0x40000>, 
  	      <0x0 0xfd5d0000 &psu_fpd_xmpu_cfg 0x0 0xfd5d0000 0x0 0x10000>, 
  	      <0x0 0xfd4f0000 &psu_fpd_xmpu_sink 0x0 0xfd4f0000 0x0 0x10000>, 
  	      <0x0 0xfd500000 &fpd_dma_chan1 0x0 0xfd500000 0x0 0x10000>, 
  	      <0x0 0xfd510000 &fpd_dma_chan2 0x0 0xfd510000 0x0 0x10000>, 
  	      <0x0 0xfd520000 &fpd_dma_chan3 0x0 0xfd520000 0x0 0x10000>, 
  	      <0x0 0xfd530000 &fpd_dma_chan4 0x0 0xfd530000 0x0 0x10000>, 
  	      <0x0 0xfd540000 &fpd_dma_chan5 0x0 0xfd540000 0x0 0x10000>, 
  	      <0x0 0xfd550000 &fpd_dma_chan6 0x0 0xfd550000 0x0 0x10000>, 
  	      <0x0 0xfd560000 &fpd_dma_chan7 0x0 0xfd560000 0x0 0x10000>, 
  	      <0x0 0xfd570000 &fpd_dma_chan8 0x0 0xfd570000 0x0 0x10000>, 
  	      <0x0 0xff0a0000 &gpio 0x0 0xff0a0000 0x0 0x10000>, 
  	      <0x0 0xff030000 &i2c1 0x0 0xff030000 0x0 0x10000>, 
  	      <0x0 0xff250000 &psu_iou_scntr 0x0 0xff250000 0x0 0x10000>, 
  	      <0x0 0xff260000 &psu_iou_scntrs 0x0 0xff260000 0x0 0x10000>, 
  	      <0x0 0xff240000 &psu_iousecure_slcr 0x0 0xff240000 0x0 0x10000>, 
  	      <0x0 0xff180000 &psu_iouslcr_0 0x0 0xff180000 0x0 0xc0000>, 
  	      <0x0 0xff410000 &psu_lpd_slcr 0x0 0xff410000 0x0 0xa0000>, 
  	      <0x0 0xff4b0000 &psu_lpd_slcr_secure 0x0 0xff4b0000 0x0 0x30000>, 
  	      <0x0 0xff980000 &lpd_xppu 0x0 0xff980000 0x0 0x10000>, 
  	      <0x0 0xff9c0000 &psu_lpd_xppu_sink 0x0 0xff9c0000 0x0 0x10000>, 
  	      <0x0 0xffcf0000 &psu_mbistjtag 0x0 0xffcf0000 0x0 0x10000>, 
  	      <0x0 0xff990000 &psu_message_buffers 0x0 0xff990000 0x0 0x10000>, 
  	      <0x0 0xff960000 &ocm 0x0 0xff960000 0x0 0x10000>, 
  	      <0x0 0xffa70000 &psu_ocm_xmpu_cfg 0x0 0xffa70000 0x0 0x10000>, 
  	      <0x0 0xffd80000 &psu_pmu_global_0 0x0 0xffd80000 0x0 0x40000>, 
  	      <0x0 0xff0f0000 &qspi 0x0 0xff0f0000 0x0 0x10000>, 
  	      <0x0 0xc0000000 &psu_qspi_linear_0_memory 0x0 0xc0000000 0x0 0x20000000>, 
  	      <0x0 0xffe00000 &psu_r5_0_atcm_global 0x0 0xffe00000 0x0 0x10000>, 
  	      <0x0 0xffe20000 &psu_r5_0_btcm_global 0x0 0xffe20000 0x0 0x10000>, 
  	      <0x0 0xffe90000 &psu_r5_1_atcm_global 0x0 0xffe90000 0x0 0x10000>, 
  	      <0x0 0xffeb0000 &psu_r5_1_btcm_global 0x0 0xffeb0000 0x0 0x10000>, 
  	      <0x0 0xffe00000 &psu_r5_tcm_ram_global 0x0 0xffe00000 0x0 0x40000>, 
  	      <0x0 0xff9a0000 &psu_rpu 0x0 0xff9a0000 0x0 0x10000>, 
  	      <0x0 0xffce0000 &psu_rsa 0x0 0xffce0000 0x0 0x10000>, 
  	      <0x0 0xffa60000 &rtc 0x0 0xffa60000 0x0 0x10000>, 
  	      <0x0 0xff160000 &sdhci0 0x0 0xff160000 0x0 0x10000>, 
  	      <0x0 0xff170000 &sdhci1 0x0 0xff170000 0x0 0x10000>, 
  	      <0x0 0xfd400000 &psgtr 0x0 0xfd400000 0x0 0x80000>, 
  	      <0x0 0xfd3d0000 &psu_siou 0x0 0xfd3d0000 0x0 0x10000>, 
  	      <0x0 0xfd800000 &smmu 0x0 0xfd800000 0x0 0x800000>, 
  	      <0x0 0xfd5f0000 &psu_smmu_reg 0x0 0xfd5f0000 0x0 0x10000>, 
  	      <0x0 0xff040000 &spi0 0x0 0xff040000 0x0 0x10000>, 
  	      <0x0 0xff110000 &ttc0 0x0 0xff110000 0x0 0x10000>, 
  	      <0x0 0xff120000 &ttc1 0x0 0xff120000 0x0 0x10000>, 
  	      <0x0 0xff130000 &ttc2 0x0 0xff130000 0x0 0x10000>, 
  	      <0x0 0xff140000 &ttc3 0x0 0xff140000 0x0 0x10000>, 
  	      <0x0 0xff000000 &uart0 0x0 0xff000000 0x0 0x10000>, 
  	      <0x0 0xff9e0000 &usb1 0x0 0xff9e0000 0x0 0x10000>, 
  	      <0x0 0xfe300000 &dwc3_1 0x0 0xfe300000 0x0 0x100000>, 
  	      <0x0 0xff150000 &lpd_watchdog 0x0 0xff150000 0x0 0x10000>, 
  	      <0x0 0xfd4d0000 &watchdog0 0x0 0xfd4d0000 0x0 0x10000>;
};

//&cpus_a53 {
//  address-map = <0x0 0xa0002000 &axi_iic_pl2_inst 0x0 0xa0002000 0x0 0x200>;
//};
