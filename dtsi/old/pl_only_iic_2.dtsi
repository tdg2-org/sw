&M_AXI_iic_0 {
  compatible = "xlnx,axi-iic-2.1", "xlnx,xps-iic-2.00.a";
  xlnx,iic-freq-khz = <100>;
  xlnx,iic-freq = <100000>;
  reg = <0x0 0xa0020000 0x0 0x200>;  // Optional: if you want to be explicit
  clocks = <&zynqmp_clk 71>;
  clock-names = "s_axi_aclk";
  status = "okay";
};
