&M_AXI_iic_0 {
  xlnx,iic-freq-khz = <100>;
  compatible = "xlnx,axi-iic-2.1" , "xlnx,xps-iic-2.00.a";
  xlnx,scl-inertial-delay = <0>;
  xlnx,ip-name = "axi_iic";
  xlnx,disable-setup-violation-check = <0>;
  reg = <0x0 0xa0020000 0x0 0x200>;
  clocks = <&zynqmp_clk 71>;
  xlnx,gpo-width = <1>;
  xlnx,edk-iptype = "PERIPHERAL";
  xlnx,static-timing-reg-width = <0>;
  xlnx,sda-level = <1>;
  status = "okay";
  clock-names = "s_axi_aclk";
  xlnx,ten-bit-adr = <0>;
  xlnx,default-value = <0x0>;
  xlnx,iic-board-interface = "Custom";
  xlnx,timing-reg-width = <32>;
  xlnx,iic-freq = <100000>;
  xlnx,smbus-pmbus-host = <0>;
  xlnx,name = "axi_iic_pl_inst";
  xlnx,axi-aclk-freq-mhz = <100>;
  xlnx,sda-inertial-delay = <0>;
};