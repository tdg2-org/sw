&i2c_pl {
  compatible = "xlnx,axi-iic-2.1", "xlnx,xps-iic-2.00.a";
  reg = <0x0 0xa0001000 0x0 0x200>;
  status = "okay";
  xlnx,ten-bit-adr = <0>;
  xlnx,gpo-width = <1>;
  clocks = <&zynqmp_clk 71>;
  clock-names = "s_axi_aclk";
};
